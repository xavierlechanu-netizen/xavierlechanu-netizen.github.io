## hardware/firmware/components/blackbox/Kconfig
```kconfig
menu "Boîte noire"

    config BLACKBOX_DEV_SELF_KEYS
        bool "Développement : clé ECDSA générée sur place si le boîtier n'est pas provisionné"
        default n
        help
            À ne JAMAIS activer pour un boîtier vendu. En production, les clés
            viennent du provisionnement usine (tools/provision_blackbox.py) et
            la clé publique est enregistrée côté serveur ; un boîtier sans clé
            fige les accidents mais ne les signe pas.

endmenu
```
